## components/keyboard/Kconfig
```kconfig
menu "Keyboard configuration"
        config KB_DEV_GPIO_A0_PIN
            int "HC138 A0 Pin GPIO number"
            default 8 if IDF_TARGET_ESP32S3
            default 8

        config KB_DEV_GPIO_A1_PIN
            int "HC138 A1 Pin GPIO number"
            default 9 if IDF_TARGET_ESP32S3
            default 9

        config KB_DEV_GPIO_A2_PIN
            int "HC138 A2 Pin GPIO number"
            default 11 if IDF_TARGET_ESP32S3
            default 11

        config KB_DEV_GPIO_SCAN_Y0_PIN
            int "Keyboard scan Y0 GPIO number"
            default 13 if IDF_TARGET_ESP32S3
            default 13

        config KB_DEV_GPIO_SCAN_Y1_PIN
            int "Keyboard scan Y1 GPIO number"
            default 15 if IDF_TARGET_ESP32S3
            default 15

        config KB_DEV_GPIO_SCAN_Y2_PIN
            int "Keyboard scan Y2 GPIO number"
            default 3 if IDF_TARGET_ESP32S3
            default 3

        config KB_DEV_GPIO_SCAN_Y3_PIN
            int "Keyboard scan Y3 GPIO number"
            default 4 if IDF_TARGET_ESP32S3
            default 4

        config KB_DEV_GPIO_SCAN_Y4_PIN
            int "Keyboard scan Y4 GPIO number"
            default 5 if IDF_TARGET_ESP32S3
            default 5

        config KB_DEV_GPIO_SCAN_Y5_PIN
            int "Keyboard scan Y5 GPIO number"
            default 6 if IDF_TARGET_ESP32S3
            default 6

        config KB_DEV_GPIO_SCAN_Y6_PIN
            int "Keyboard scan Y6 GPIO number"
            default 7 if IDF_TARGET_ESP32S3
            default 7

endmenu
```

## components/sdcard_fs/Kconfig
```kconfig
menu "SD card configuration"

    choice SDMMC_BUS_WIDTH
        prompt "SD/MMC bus width"
        default SDMMC_BUS_WIDTH_1
        help
            Select the bus width of SD or MMC interface.
            Note that even if 1 line mode is used, D3 pin of the SD card must have a pull-up resistor connected.
            Otherwise the card may enter SPI mode, the only way to recover from which is to cycle power to the card.

        config SDMMC_BUS_WIDTH_4
            bool "4 lines (D0 - D3)"

        config SDMMC_BUS_WIDTH_1
            bool "1 line (D0)"
    endchoice

    if SOC_SDMMC_USE_GPIO_MATRIX

        config SDIO_PIN_CMD
            int "CMD GPIO number"
            default 14 if IDF_TARGET_ESP32S3
            default 14

        config SDIO_PIN_CLK
            int "CLK GPIO number"
            default 40 if IDF_TARGET_ESP32S3
            default 40

        config SDIO_PIN_D0
            int "D0 GPIO number"
            default 39 if IDF_TARGET_ESP32S3
            default 39

        if SDMMC_BUS_WIDTH_4

            config SDIO_PIN_D1
                int "D1 GPIO number"
                default 38 if IDF_TARGET_ESP32S3
                default 40 if IDF_TARGET_ESP32P4

            config SDIO_PIN_D2
                int "D2 GPIO number"
                default 33 if IDF_TARGET_ESP32S3
                default 41 if IDF_TARGET_ESP32P4

            config SDIO_PIN_D3
                int "D3 GPIO number"
                default 34 if IDF_TARGET_ESP32S3
                default 42 if IDF_TARGET_ESP32P4

        endif  # SDMMC_BUS_WIDTH

    endif  # SOC_SDMMC_USE_GPIO_MATRIX

endmenu
```

## sdkconfig.defaults
```kconfig
CONFIG_ESP_WIFI_SOFTAP_SUPPORT=n
CONFIG_ESPTOOLPY_FLASH_MODE_AUTO_DETECT=y
CONFIG_ESPTOOLPY_FLASHMODE_DIO=y
CONFIG_ESPTOOLPY_FLASHSIZE_8MB=y
CONFIG_ESPTOOLPY_FLASHSIZE="8MB"
CONFIG_ESPTOOLPY_MONITOR_BAUD=115200
# For lvgl settings.
CONFIG_LV_COLOR_DEPTH=16
CONFIG_LV_COLOR_16_SWAP=y
CONFIG_LV_DISP_DEF_REFR_PERIOD=40
CONFIG_LV_INDEV_DEF_READ_PERIOD=10
CONFIG_LV_MEM_CUSTOM=y
CONFIG_LV_MEM_CUSTOM_INCLUDE="stdlib.h"
CONFIG_LV_MEM_BUF_MAX_NUM=16
CONFIG_LV_USE_THEME_DEFAULT=n
CONFIG_LV_USE_THEME_BASIC=y
CONFIG_LV_USE_THEME_MONO=n

CONFIG_LV_USE_FS_STDIO=y
# letter default as 'S'
CONFIG_LV_FS_STDIO_LETTER=83
CONFIG_LV_FS_STDIO_PATH="/sdcard"
CONFIG_LV_FS_STDIO_CACHE_SIZE=0

CONFIG_LV_FONT_FMT_TXT_LARGE=y

# Filesystem support
CONFIG_FATFS_LFN_HEAP=y
CONFIG_FATFS_CODEPAGE_437=y
CONFIG_FATFS_CODEPAGE=437
CONFIG_FATFS_MAX_LFN=255
CONFIG_FATFS_API_ENCODING_ANSI_OEM=y
```
